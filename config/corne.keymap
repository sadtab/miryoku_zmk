// Copyright 2021 Manna Harbour
// https://github.com/manna-harbour/miryoku

#include "../miryoku/custom_config.h"
#include "../miryoku/mapping/42/corne.h"
#include "../miryoku/miryoku.dtsi"

// Specify the chain-length of LEDs
// &led_strip {
//     // chain-length = <6>;  // Under keyboard 
//     chain-length = <27>;  // All 
// };
